// SPDX-License-Identifier: (GPL-2.0-or-later OR BSD-3-Clause)
/*
 * Copyright (C) 2025, STMicroelectronics - All Rights Reserved
 * Author: STM32CubeMX code generation for STMicroelectronics.
 */

/* For more information on Device Tree configuration, please refer to
 * https://wiki.st.com/stm32mpu/wiki/Category:Device_tree_configuration
 */
#include "stm32mp21-fw-config.dtsi"

/ {
	/* USER CODE BEGIN root */
	dtb-registry {
		soc_fw-config {
			load-address = <0x0 0x81fc0000>;
			max-size = <0x40000>;
		};
		tos_fw {
			load-address = <0x0 0x82000000>;
			max-size = <0x2000000>;
		};
	};
	/* USER CODE END root */
};

